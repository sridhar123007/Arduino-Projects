#include <ESP8266WiFi.h>
#include <PubSubClient.h>
#include <SPI.h>
#include <Wire.h>
#include <Adafruit_GFX.h>
#include <Adafruit_SSD1306.h>

#define OLED_RESET D5
/* Object named display, of the class Adafruit_SSD1306 */
Adafruit_SSD1306 display(OLED_RESET);

#if (SSD1306_LCDHEIGHT != 64)
#error("Height incorrect, please fix Adafruit_SSD1306.h!");
#endif


float temperature;
int humidity;
String command;
String data = "";


void callback(char* topic, byte* payload, unsigned int payloadLength);

// CHANGE TO YOUR WIFI CREDENTIALS
const char* ssid = "Smartbridge";
const char* password = "iotgyan@sb";

// CHANGE TO YOUR DEVICE CREDENTIALS AS PER IN IBM BLUMIX
#define ORG "nlm7m3"
#define DEVICE_TYPE "IoT"
#define DEVICE_ID "1234"
#define TOKEN "12345678" //  Authentication Token OF THE DEVICE

//  PIN DECLARATIONS

#define led1 D0
#define led2 D1
int buttonState = 0;


//-------- Customise the above values --------
const char publishTopic[] = "iot-2/evt/Data/fmt/json";
char server[] = ORG ".messaging.internetofthings.ibmcloud.com";
char topic[] = "iot-2/cmd/home/fmt/String";// cmd  REPRESENT command type AND COMMAND IS TEST OF FORMAT STRING
char authMethod[] = "use-token-auth";
char token[] = TOKEN;
char clientId[] = "d:" ORG ":" DEVICE_TYPE ":" DEVICE_ID;


WiFiClient wifiClient;
PubSubClient client(server, 1883, callback, wifiClient);

int publishInterval = 3000; // 30 seconds
long lastPublishMillis;
void publishData();

void drawStr(uint8_t x, uint8_t y, char* str);

//Created with online webtool from www.riyas.org
const unsigned char bitmapArray [] = {
0x00, 0x00, 0x00, 0x00, 0x00, 0x00, 0x00, 0x00, 0x00, 0x00, 0x00, 0x00,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 0x00, 
};

void setup() {
  display.begin(SSD1306_SWITCHCAPVCC, 0x3C); /* Initialize display with address 0x3C */
  display.clearDisplay();  /* Clear display */
  display.setTextSize(1);  /* Select font size of text. Increases with size of argument. */
  display.setTextColor(WHITE);  /* Color of text*/

  Serial.begin(115300);
  Serial.println();

  pinMode(led1, OUTPUT);
  pinMode(led2, OUTPUT);
  pinMode(D3, INPUT);
  pinMode(D4, INPUT);
  pinMode(D5, INPUT);
  wifiConnect();
  mqttConnect();
}

void loop() {
  Display();/* Every second increment clock and display */
  delay(1000);


  if (millis() - lastPublishMillis > publishInterval)
  {
    publishData();
    lastPublishMillis = millis();
  }

  if (!client.loop()) {
    mqttConnect();
  }
}

void wifiConnect() {
  Serial.print("Connecting to "); Serial.print(ssid);
  WiFi.begin(ssid, password);
  while (WiFi.status() != WL_CONNECTED) {
    delay(300);
    Serial.print(".");
  }
  Serial.print("WiFi connected, IP address: ");
  Serial.println(WiFi.localIP());
}

void mqttConnect() {
  if (!client.connected())
  {
    Serial.print("Reconnecting MQTT client to "); Serial.println(server);
    while (!client.connect(clientId, authMethod, token)) {
      Serial.print(".");
      delay(300);
    }

    initManagedDevice();
    Serial.println();
  }
}

void initManagedDevice() {
  if (client.subscribe(topic)) {

    Serial.println("subscribe to cmd OK");
  } else {
    Serial.println("subscribe to cmd FAILED");
  }
}

void callback(char* topic, byte* payload, unsigned int payloadLength) {

  Serial.print("callback invoked for topic: ");
  Serial.println(topic);

  for (int i = 0; i < payloadLength; i++) {

    command += (char)payload[i];
  }

  Serial.print("data: " + command);
  control_func();
  command = "";
}

void control_func()
{


  if (command == "A2")
  {

      display.clearDisplay();  /* Clear display */
      drawStr(30, 30, "Road Diversion");
      display.display();
      delay(1000);
  }
  else if (command == "A1")
  {
    display.clearDisplay();  /* Clear display */
    drawStr(10, 30, "Speed Limit 20Kmph");
    display.display();
    delay(1000);

  }
  else if (command == "A3")
  {
    display.clearDisplay();  /* Clear display */
    drawStr(30, 30, "School Zone");
    drawStr(00, 50, "Speed Limit 20Kmph");
    display.display();
    delay(1000);

  }


  else
  {
// Length (with one extra character for the null terminator)
int str_len = command.length() + 1; 
// Prepare the character array (the buffer) 
char char_array[str_len];
// Copy it over  
command.toCharArray(char_array, str_len);
    display.clearDisplay();  /* Clear display */
    drawStr(10, 30, char_array);
    display.display();
    delay(1000);

  }
}

void publishData()
{


 /*   Serial.print("\n");
    Serial.print("Sending payload: "); Serial.println(payload);

    if (client.publish(publishTopic, (char*) payload.c_str())) {
      Serial.println("Publish OK");
    } else {
      Serial.println("Publish FAILED");
    }*/
}

void Display() {
  buttonState = digitalRead(D3);
  int buttonState1 = digitalRead(D4);
  int buttonState2 = digitalRead(D5);
  Serial.print("buttonState: ");
  Serial.println(buttonState);
  Serial.print("buttonState1: ");
  Serial.println(buttonState1);
  // check if the pushbutton is pressed. If it is, the buttonState is HIGH:
  if (buttonState == LOW) {
    // turn LED on:
    display.clearDisplay();  /* Clear display */
    drawStr(00, 30, "Speed Limit 20Kmph");
   // display.drawBitmap(0, 0, bitmapArray, 128, 64, BLACK,WHITE);
    display.display();
    delay(1000);
  } 

  if (buttonState1 == LOW) {
    // turn LED on:
    display.clearDisplay();  /* Clear display */
    drawStr(30, 30, "Road Diversion");
    display.display();
    delay(1000);
  }
  if(buttonState2 == LOW) {
    // turn LED off:
    display.clearDisplay(); 
    drawStr(30, 30, "School Zone");
    drawStr(00, 50, "Speed Limit 20Kmph");
    display.display();
    delay(1000);
}

}
void drawStr(uint8_t x, uint8_t y, char* str) {
  display.setCursor(x, y);  /* Set x,y coordinates */
  display.println(str);
}
